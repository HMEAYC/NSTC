## NSTC/firmware/main/Kconfig.projbuild
```kconfig
menu "HMEAYC Firmware Configuration"

    config HMEAYC_DEVICE_ID
        string "Device ID"
        default "hmeayc-001"
        help
            Unique identifier for this device, sent in every IMU frame.

    config HMEAYC_FIRMWARE_VERSION
        string "Firmware Version"
        default "0.1.0"
        help
            Semver version string reported to OTA server.

    config HMEAYC_WIFI_SSID
        string "WiFi SSID"
        default "HMEAYC"

    config HMEAYC_WIFI_PASSWORD
        string "WiFi Password"
        default ""

    config HMEAYC_WS_URI
        string "WebSocket URI"
        default "ws://192.168.4.1:8080/ws/default"

    config HMEAYC_SAMPLE_RATE_HZ
        int "IMU Sample Rate (Hz)"
        default 50
        range 5 200
        help
            IMU sampling frequency. MPU6050/MPU6500 supports 5-200 Hz with DLPF enabled.

    config HMEAYC_OTA_BASE_URL
        string "OTA Server Base URL"
        default "http://192.168.4.1:8080/api/firmware"
        help
            Base URL for OTA version check and firmware download.
            Must NOT have a trailing slash.

endmenu
```

## firmware/main/Kconfig.projbuild
```kconfig
menu "HMEAYC Firmware Configuration"

    config HMEAYC_DEVICE_ID
        string "Device ID (deprecated — MAC is used instead)"
        default ""
        help
            No longer used. Device now identifies itself via WiFi MAC address.
            Kept to avoid breaking existing sdkconfig files.

    config HMEAYC_FIRMWARE_VERSION
        string "Firmware Version"
        default "1.0.0"
        help
            Semver version string reported to OTA server.

    config HMEAYC_WIFI_SSID
        string "WiFi SSID"
        default "HMEAYC"

    config HMEAYC_WIFI_PASSWORD
        string "WiFi Password"
        default ""

    config HMEAYC_WS_URI
        string "WebSocket URI"
        default ""
        help
            Base WebSocket URI. The session path is dynamically updated at runtime
            via GET /api/config/session — the ESP32 will reconnect to the correct
            session when assigned via the dashboard. If no session is assigned,
            falls back to "/ws/default". Leave empty to auto-detect from server.

    config HMEAYC_SAMPLE_RATE_HZ
        int "IMU Sample Rate (Hz)"
        default 50
        range 5 200
        help
            IMU sampling frequency. MPU6050/MPU6500 supports 5-200 Hz with DLPF enabled.

    config HMEAYC_API_BASE_URL
        string "API Server Base URL"
        default ""
        help
            Base URL for REST API calls (device registration, WiFi config fetch).
            Must NOT have a trailing slash. Leave empty to auto-detect from server.

    config HMEAYC_API_KEY
        string "API Key for device authentication"
        default "hmeayc-esp32-2025"
        help
            API key sent via X-API-Key header for device registration and config fetch.

    config HMEAYC_OTA_BASE_URL
        string "OTA Server Base URL"
        default ""
        help
            Base URL for OTA version check and firmware download.
            Must NOT have a trailing slash. Leave empty to use GitHub Pages.

    config HMEAYC_I2C_SDA_PIN
        int "I2C SDA GPIO Pin"
        default 6
        help
            GPIO pin number for I2C SDA (MPU6500).

    config HMEAYC_I2C_SCL_PIN
        int "I2C SCL GPIO Pin"
        default 7
        help
            GPIO pin number for I2C SCL (MPU6500).

endmenu
```

## firmware/sdkconfig.defaults
```kconfig
# ESP32-C3 target
CONFIG_IDF_TARGET="esp32c3"

# Flash size (ESP32-C3 SuperMini has 4MB)
CONFIG_ESPTOOLPY_FLASHSIZE_4MB=y

# Custom OTA partition table
CONFIG_PARTITION_TABLE_CUSTOM=y
CONFIG_PARTITION_TABLE_FILENAME="partitions.csv"

# Enable OTA support
CONFIG_APP_ROLLBACK_ENABLE=y
CONFIG_BOOTLOADER_APP_ROLLBACK_ENABLE=y
CONFIG_BOOTLOADER_SKIP_VALIDATE_IN_DOWN_MODE=y

# Enable HTTPS for OTA (GitHub Pages)
CONFIG_ESP_HTTP_CLIENT_ENABLE_HTTPS=y
CONFIG_ESP_TLS_ENABLED=y

# Enable app update via OTA
CONFIG_HTTPD_WS_SUPPORT=n

# mDNS for hostname resolution (no more hardcoded IPs)
# lwip's CONFIG_LWIP_DNS_SUPPORT_MDNS_QUERIES is already default y

# WiFi credentials (configure via NVS or override at build time)
CONFIG_HMEAYC_WIFI_SSID="LIN"
CONFIG_HMEAYC_WIFI_PASSWORD="22131081"

# SmartConfig disabled (replaced by SoftAP captive portal)
CONFIG_ESP_WIFI_SOFTAP_SUPPORT=y

# Firmware version
CONFIG_HMEAYC_FIRMWARE_VERSION="1.0.0"

# API server base URL (Mac LAN IP, backend on port 8000)
CONFIG_HMEAYC_API_BASE_URL="http://192.168.1.195:8000"

# API key for device authentication
CONFIG_HMEAYC_API_KEY="hmeayc-esp32-2025"

# OTA endpoint (GitHub Pages)
CONFIG_HMEAYC_OTA_BASE_URL="https://HMEAYC.github.io/NSTC/ota"

# Main task stack size (needs ~8KB for HTTP client + JSON buffers)
CONFIG_ESP_MAIN_TASK_STACK_SIZE=8192
```
